## CMakeLists.txt
```
# SPDX-License-Identifier: Apache-2.0

cmake_minimum_required(VERSION 3.20.0)

find_package(Zephyr REQUIRED HINTS $ENV{ZEPHYR_BASE})
project(SmartBox_firmware)

target_include_directories(app PRIVATE 
    SW/SRV/
    SW/HAL/Hal_Led/src
    SW/HAL/Hal_Led/cfg
    SW/APP/App_Led/src
    SW/APP/App_Led/cfg
)

target_sources(app PRIVATE 
    SW/main.c 
    SW/HAL/Hal_Led/src/hal_led.c
    SW/APP/App_Led/src/app_led.c)
```

## prj.conf
```kconfig
# RTT configuration
CONFIG_USE_SEGGER_RTT=y
CONFIG_RTT_CONSOLE=y
CONFIG_BOARD_SERIAL_BACKEND_CDC_ACM=n
CONFIG_UART_CONSOLE=n

#GPIO
CONFIG_GPIO=y

# PWM
CONFIG_PWM=y
CONFIG_LED=y
CONFIG_LED_PWM=y

# RTOS features
CONFIG_EVENTS=y
```

## src/main.c
```c
#include <zephyr/kernel.h>
#include <zephyr/sys/printk.h>

#define MY_STACK_SIZE 512
#define MY_PRIORITY 7

void test_thread(void);

int main(void)
{
	printk("Hello World! %s\n", CONFIG_BOARD_TARGET);

	return 0;
}

void test_thread(void)
{
	uint16_t cnt = 0;

	while(1)
	{	
		cnt++;

		printk("Sleep for %d seconds ...\n", cnt);

		k_sleep(K_SECONDS(cnt));
	}
}

K_THREAD_DEFINE(thread1, MY_STACK_SIZE, test_thread, NULL, NULL, NULL, MY_PRIORITY, 0, 0);
```
