/***********************************************************************************************************
 ********************************************* Included files **********************************************
 ***********************************************************************************************************/

#include "drv_gpio.h"
#include <zephyr/drivers/gpio.h>

/***********************************************************************************************************
 ************************************************* Macros **************************************************
 ***********************************************************************************************************/

/***********************************************************************************************************
 *********************************************** Data types ************************************************
 ***********************************************************************************************************/

/**
 * @brief Structure to hold GPIO specification.
 */
typedef struct {
    struct gpio_dt_spec spec;
    uint32_t direction;
    uint32_t interrupts;
}Drv_Gpio_Spec_t;

/***********************************************************************************************************
 **************************************** Local function prototypes ****************************************
 ***********************************************************************************************************/

/***********************************************************************************************************
 ******************************************** Exported objects *********************************************
 ***********************************************************************************************************/

/***********************************************************************************************************
 ********************************************* Local objects ***********************************************
 ***********************************************************************************************************/

static const Drv_Gpio_Spec_t Hal_Gpio_Spec[DRV_GPIO_PIN_MAX] = {
    #define DRV_GPIO_GENERATE_SPEC(name, label, prop, dir, int) {GPIO_DT_SPEC_GET(DT_NODELABEL(label), prop), dir, int},
    DRV_GPIO_PINS_CFG_TABLE(DRV_GPIO_GENERATE_SPEC)
    #undef DRV_GPIO_GENERATE_SPEC
};

/***********************************************************************************************************
 ******************************************* Exported functions ********************************************
 ***********************************************************************************************************/

/**
 * @brief Initialize the GPIO driver.
 * 
 * @return System_Ret_t SYSTEM_OK if initialization is successful, otherwise SYSTEM_NOK.
 */
System_Ret_t Drv_Gpio_Init(void)
{
    System_Ret_t ret = SYSTEM_OK;

    for(uint8_t i = 0; i < (uint8_t)DRV_GPIO_PIN_MAX; i++)
    {
        if(true != device_is_ready(Hal_Gpio_Spec[i].spec.port))
        {
            ret = SYSTEM_NOK;
        }

        if(0 > gpio_pin_configure_dt(&Hal_Gpio_Spec[i].spec, Hal_Gpio_Spec[i].direction))
        {
            ret = SYSTEM_NOK;
        }
    }

    return ret;
}

/**
 * @brief Write a state to a OUTPUT pin.
 * 
 * @param pin The GPIO pin to write to.
 * @param state The state to write (DRV_GPIO_PIN_STATE_ACTIVE or DRV_GPIO_PIN_STATE_INACTIVE).
 */
void Drv_Gpio_Write(Drv_Gpio_Pin_t pin, int state)
{
    if(pin < DRV_GPIO_PIN_MAX)
    {
        gpio_pin_set_dt(&Hal_Gpio_Spec[pin].spec, state);   
    }
}

/**
 * @brief Read the state of a INPUT pin.
 * 
 * @param pin The GPIO pin to read from.
 * @return int The state of the GPIO pin (DRV_GPIO_PIN_STATE_ACTIVE or DRV_GPIO_PIN_STATE_INACTIVE).
 */
int Drv_Gpio_Read(Drv_Gpio_Pin_t pin)
{
    return gpio_pin_get_dt(&Hal_Gpio_Spec[pin].spec);
}

/***********************************************************************************************************
 ******************************************** Local functions **********************************************
 ***********************************************************************************************************/
