/***********************************************************************************************************
 ********************************************* Included files **********************************************
 ***********************************************************************************************************/

#include "hal_ipc_decode.h"

/***********************************************************************************************************
 ************************************************* Macros **************************************************
 ***********************************************************************************************************/

/* Indexes of fields in IPC message */
#define HAL_IPC_MESSAGE_ID_IDX       (0U)
#define HAL_IPC_MESSAGE_LEN_IDX      (1U)
#define HAL_IPC_MESSAGE_PAYLOAD_IDX  (2U)

/***********************************************************************************************************
 *********************************************** Data types ************************************************
 ***********************************************************************************************************/

/***********************************************************************************************************
 **************************************** Local function prototypes ****************************************
 ***********************************************************************************************************/

/***********************************************************************************************************
 ******************************************** Exported objects *********************************************
 ***********************************************************************************************************/

/***********************************************************************************************************
 ********************************************* Local objects ***********************************************
 ***********************************************************************************************************/

static uint8_t Hal_Ipc_DataVbatt[HAL_IPC_VBAT_LEN];

/***********************************************************************************************************
 ******************************************* Exported functions ********************************************
 ***********************************************************************************************************/

void Hal_Ipc_Decode(uint8_t len, uint8_t* data)
{
    uint8_t id = data[HAL_IPC_MESSAGE_ID_IDX];
    uint8_t payload_len = data[HAL_IPC_MESSAGE_LEN_IDX];
    uint8_t* data_ptr = NULL_PTR;

    switch (id)
    {
        case HAL_IPC_VBATT:
            data_ptr = Hal_Ipc_DataVbatt;
            break;
        
        default:
            break;
    }

    if(NULL_PTR != data_ptr)
    {
        for(uint8_t i = 0; i < payload_len; i++)
        {
            data_ptr[i] = data[HAL_IPC_MESSAGE_PAYLOAD_IDX + i];
        }
    }
}

void Hal_Ipc_Get(Hal_Ipc_DataType_t type, uint8_t* data)
{
    switch (type)
    {
        case HAL_IPC_VBATT:
            for(uint8_t i = 0; i < HAL_IPC_VBAT_LEN; i++)
            {
                data[i] = Hal_Ipc_DataVbatt[i];
            }
            break;
        
        default:
            break;
    }
}

/***********************************************************************************************************
 ******************************************** Local functions **********************************************
 ***********************************************************************************************************/
